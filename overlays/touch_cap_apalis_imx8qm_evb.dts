/dts-v1/;
/plugin/;

#include "dt-bindings/interrupt-controller/irq.h"
#include "dt-bindings/gpio/gpio.h"

/ {

	compatible = "toradex,apalis-imx8qm";
	fragment@0 {
		target-path="/i2c@5a820000";
		__overlay__ {
			status = "okay";
			atmel_mxt_ts@4a {
				compatible = "atmel,maxtouch";
				pinctrl-names = "default";
				pinctrl-0 = <&pinctrl_touch>;
				reg = <0x4a>;
				interrupt-parent = <&gpio4>;
				interrupts = <1 IRQ_TYPE_EDGE_FALLING>;    /* Apalis GPIO5 */
				reset-gpios = <&gpio4 2 GPIO_ACTIVE_HIGH>; /* Apalis GPIO6 */
				status = "okay";
			};

		};
	};
};
