/dts-v1/;
/plugin/;
/ {
	compatible = "toradex,apalis-imx8x";
	fragment@0 {
		target-path = "/lcdif@5a180000";
		__overlay__ {
			status = "okay";
		};
	};

	fragment@1 {
		target-path = "/panel-1";
		__overlay__ {
			compatible = "panel-dpi";

			width-mm = <217>;
			height-mm = <136>;

			data-mapping = "bgr666";

			panel-timing {
				clock-frequency = <33260000>;
				hactive = <800>;
				vactive = <480>;
				hback-porch = <88>;
				hfront-porch = <40>;
				vback-porch = <32>;
				vfront-porch = <13>;
				hsync-len = <48>;
				vsync-len = <3>;

				de-active = <1>;
				hsync-active = <0>;
				vsync-active = <0>;
				pixelclk-active = <0>;
			};
		};
	};
};
