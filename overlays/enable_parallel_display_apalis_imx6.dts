/dts-v1/;
/plugin/;

/ {
        compatible = "toradex,apalis_imx6q";
        fragment@0 {
                target-path = "/disp0";
                __overlay__ {
                        status = "okay";
                };
        };
};
