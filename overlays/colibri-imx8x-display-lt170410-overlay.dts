// LT170410 display (10inch) with a resolution of 1280x800 pixel. This display can be ordered at Toradex.

/dts-v1/;
/plugin/;
/ {
	compatible = "toradex,colibri-imx8qxp";
	fragment@0 {
		target = <&adma_lcdif>;
		__overlay__ {
			status = "okay";
		};
	};

	fragment@1 {
		target-path = "/panel";
		__overlay__ {
			compatible = "panel-dpi";

			width-mm = <217>;
			height-mm = <136>;

			data-mapping = "bgr666";

			panel-timing {
				clock-frequency = <33260000>;
				hactive = <800>;
				vactive = <480>;
				hback-porch = <88>;
				hfront-porch = <40>;
				vback-porch = <32>;
				vfront-porch = <13>;
				hsync-len = <48>;
				vsync-len = <3>;

				de-active = <1>;
				hsync-active = <0>;
				vsync-active = <0>;
				pixelclk-active = <1>;
			};
		};
	};
};
