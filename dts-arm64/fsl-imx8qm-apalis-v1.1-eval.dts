// SPDX-License-Identifier: GPL-2.0+ OR X11
/*
 * Copyright 2020 Toradex
 */

/dts-v1/;

#include "fsl-imx8qm-apalis-v1.1.dtsi"
#include "fsl-imx8qm-apalis-eval.dtsi"

/ {
	model = "Toradex Apalis iMX8QM/QP on Apalis Evaluation Board";
	compatible = "toradex,apalis-imx8qm-v1.1-eval", "toradex,apalis-imx8qm", "fsl,imx8qm";
};